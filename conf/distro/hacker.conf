## conf/distro/hacker.conf
```bitbake
#
# Sample hacker configuration which the user can either add in local.conf
# or specific in an configuration file like this, then require it.
#

require conf/distro/poky.conf

DISTRO = "hacker"
DISTRO_NAME = "Hacker"
DISTRO_VERSION = "6.6.6"

#
# Use systemd for system initialization
#
DISTRO_FEATURES_BACKFILL_CONSIDERED += "sysvinit"
VIRTUAL-RUNTIME_login_manager = "shadow-base"
VIRTUAL-RUNTIME_init_manager = "systemd"
VIRTUAL-RUNTIME_initscripts = "systemd-compat-units"

#
# Hacker
#

DISTRO_FEATURES_remove = "x11"
DISTRO_FEATURES_append = " systemd directfb opengl bluetooth wifi"

EXTRA_IMAGE_FEATURES += "package-management ssh-server-openssh"

IMAGE_INSTALL_append = " apt gnupg coreutils util-linux e2fsprogs-resize2fs bluez5"
IMAGE_INSTALL_append += " base-files bash bash-completion git vim"

#DISABLE_OVERSCAN = "1"

#MACHINE_FEATURES += "pitft"

#ENABLE_SPI_BUS = "1"
#ENABLE_I2C = "1"
#ENABLE_UART = "1"

#VIRTUAL-RUNTIME_init_manager = "systemd"
#DISTRO_FEATURES_BACKFILL_CONSIDERED = "sysvinit"
#VIRTUAL-RUNTIME_initscripts = ""

#DISTRO_FEATURES += " systemd bluez5 bluetooth wifi "
#IMAGE_INSTALL += " linux-firmware-bcm43430 bluez5 i2c-tools python-smbus bridge-utils hostapd dhcp-server iptables wpa-supplicant connman connman-client openssh-sshd "
```

## conf/layer.conf
```bitbake
# We have a conf and classes directory, add to BBPATH
BBPATH .= ":${LAYERDIR}"

# We have recipes-* directories, add to BBFILES
BBFILES += "${LAYERDIR}/recipes-*/*/*.bb \
            ${LAYERDIR}/recipes-*/*/*.bbappend"

BBFILE_COLLECTIONS += "meta-hacker"
BBFILE_PATTERN_meta-hacker = "^${LAYERDIR}/"
BBFILE_PRIORITY_meta-hacker = "6"

LAYERDEPENDS_meta-hacker = "core"
LAYERSERIES_COMPAT_meta-hacker = "warrior zeus"
```
